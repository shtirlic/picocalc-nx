## Kconfig
```kconfig
#
# For a description of the syntax of this configuration file,
# see the file kconfig-language.txt in the NuttX tools repository.
#

config ARCH_BOARD_PICOCALC
	bool "Raspberry Pi Pico 2 based PicoCalc"
	default y
	depends on ARCH_CHIP_RP23XX
	select ARCH_HAVE_LEDS
	select ARM_HAVE_DSP
	# select ARCH_HAVE_MPU

	---help---
		This is a port to the PicoCacl on Raspberry Pi Pico 2 board.

if ARCH_BOARD_PICOCALC

	config PICOCALC_LCD
		bool "PicoCalc LCD Driver"
		default y
		select LCD
		select LCD_DEV
		select LCD_PORTRAIT
		select LCD_ILI9341
		select LCD_ILI9341_IFACE0
		select GRAPHICS_LVGL
		select CUSTOM_APPS_ATOMSHELL
    select LV_USE_LOG
    select LV_USE_NUTTX
    select LV_USE_NUTTX_LCD

		---help---
			PicoCalc LCD driver

	config INPUT_PICOCALC_KBD
		bool "PicoCalc Keyboard Input Driver"
		default y
		select INPUT_KEYBOARD
		---help---
			PicoCalc Keyboard Input Driver

	config INPUT_PICOCALC_KBD_BUFFSIZE
		int "PicoCalc keyboard buffer size"
		default 64
		depends on INPUT_PICOCALC_KBD
		---help---
			PicoCalc keyboard buffer size

endif
```
